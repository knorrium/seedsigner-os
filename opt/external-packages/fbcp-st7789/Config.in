## opt/external-packages/fbcp-st7789/Config.in
```kconfig
config BR2_PACKAGE_FBCP_ST7789
	bool "fbcp-st7789"
	depends on BR2_INSTALL_LIBSTDCPP
	select BR2_PACKAGE_RPI_USERLAND
	help
	  Low-latency VideoCore framebuffer mirror for the Waveshare 1.3-inch
	  240x240 ST7789VW HAT, tuned for the single-core Raspberry Pi Zero.
```

## opt/external-packages/libretro-fceumm/Config.in
```kconfig
config BR2_PACKAGE_LIBRETRO_FCEUMM
	bool "libretro-fceumm"
	help
	  Nintendo Entertainment System libretro core.
```

## opt/external-packages/libretro-gambatte/Config.in
```kconfig
config BR2_PACKAGE_LIBRETRO_GAMBATTE
	bool "libretro-gambatte"
	depends on BR2_INSTALL_LIBSTDCPP
	help
	  Game Boy and Game Boy Color libretro core.
```

## opt/external-packages/retroarch/Config.in
```kconfig
config BR2_PACKAGE_RETROARCH
	bool "retroarch"
	depends on BR2_TOOLCHAIN_HAS_THREADS
	depends on !BR2_STATIC_LIBS
	select BR2_PACKAGE_SDL2
	help
	  Minimal offline RetroArch frontend using SDL2.

	  https://www.retroarch.com/
```
